AUTOSAR XML (schema 4-0-3)
# Copyright (C) 2011-2013 by Center for Embedded Computing Systems
# Graduate School of Information Science, Nagoya Univ., JAPAN
# Copyright (C) 2011-2013 by FUJISOFT INCORPORATED, JAPAN
# Copyright (C) 2011-2013 by FUJITSU VLSI LIMITED, JAPAN
# Copyright (C) 2011-2013 by NEC Communication Systems, Ltd., JAPAN
# Copyright (C) 2011-2013 by Panasonic Advanced Technology Development Co., Ltd., JAPAN
# Copyright (C) 2011-2013 by Renesas Electronics Corporation, JAPAN
# Copyright (C) 2011-2013 by Sunny Giken Inc., JAPAN
# Copyright (C) 2011-2013 by TOSHIBA CORPORATION, JAPAN
# Copyright (C) 2011-2013 by Witz Corporation, JAPAN
package /Ecuc
  module config Os: ecuc-def-edition=4.0.3, implementation-config-variant=VARIANT-PRE-COMPILE
    OsInclude: OsIncludeFileName=toppers_atk2.h
    AppMode1 (OsAppMode)
    OsOS: OsScalabilityClass=SC1, OsStackMonitoring=true, OsStatus=EXTENDED, OsUseGetServiceId=true, OsUseParameterAccess=true
      OsHooks: OsErrorHook=false, OsPostTaskHook=false, OsPreTaskHook=false, OsProtectionHook=false, OsShutdownHook=false, OsStartupHook=true
      OsHookStack: OsHookStackSize=0x200
    main_task (OsTask): OsTaskActivation=1U, OsTaskPriority=10, OsTaskSchedule=FULL, OsTaskStackSize=0x250, OsTaskEventRef=EVENT_CONSOLE_IN
      OsTaskAutostart: OsTaskAppModeRef=AppMode1
    led_task (OsTask): OsTaskActivation=1U, OsTaskPriority=5, OsTaskSchedule=FULL, OsTaskStackSize=0x250
      OsTaskAutostart: OsTaskAppModeRef=AppMode1
    EVENT_CONSOLE_IN (OsEvent)
    alarm_console_in (OsAlarm): OsAlarmCounterRef=MAIN_HW_COUNTER
      OsAlarmAction
        OsAlarmSetEvent: OsAlarmSetEventTaskRef=main_task, OsAlarmSetEventRef=EVENT_CONSOLE_IN
      OsAlarmAutostart: OsAlarmAlarmTime=TICK_FOR_10MS, OsAlarmCycleTime=TICK_FOR_10MS, OsAlarmAutostartType=ABSOLUTE, OsAlarmAppModeRef=AppMode1
