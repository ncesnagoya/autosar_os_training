AUTOSAR XML (schema 4-0-3)
package /Ecuc
  module config Os: ecuc-def-edition=4.2.0, implementation-config-variant=VARIANT-PRE-COMPILE
    OsInclude: OsIncludeFileName=toppers_atk2.h
    AppMode1 (OsAppMode)
    OsOS: OsStackMonitoring=true, OsUseGetServiceId=true, OsUseParameterAccess=true, OsScalabilityClass=SC1, OsStatus=EXTENDED
      OsHooks: OsErrorHook=false, OsPostTaskHook=false, OsPreTaskHook=false, OsProtectionHook=false, OsShutdownHook=false, OsStartupHook=true
      OsHookStack: OsHookStackSize=512
    main_task (OsTask): OsTaskActivation=1, OsTaskPriority=10, OsTaskStackSize=592, OsTaskSchedule=FULL, OsTaskEventRef=EVENT_CONSOLE_IN
      OsTaskAutostart: OsTaskAppModeRef=AppMode1
    led_task (OsTask): OsTaskActivation=1, OsTaskPriority=5, OsTaskStackSize=592, OsTaskSchedule=FULL
      OsTaskAutostart: OsTaskAppModeRef=AppMode1
    EVENT_CONSOLE_IN (OsEvent)
    alarm_console_in (OsAlarm): OsAlarmCounterRef=MAIN_HW_COUNTER
      OsAlarmAction
        OsAlarmSetEvent: OsAlarmSetEventTaskRef=main_task, OsAlarmSetEventRef=EVENT_CONSOLE_IN
      OsAlarmAutostart: OsAlarmAlarmTime=TICK_FOR_10MS, OsAlarmCycleTime=TICK_FOR_10MS, OsAlarmAutostartType=ABSOLUTE, OsAlarmAppModeRef=AppMode1
