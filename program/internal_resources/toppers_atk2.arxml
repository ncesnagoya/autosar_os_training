AUTOSAR XML (schema 4-0-3)
package /Ecuc
  module config Os: ecuc-def-edition=4.2.0, implementation-config-variant=VARIANT-PRE-COMPILE
    OsInclude: OsIncludeFileName=toppers_atk2.h
    AppMode1 (OsAppMode)
    OsOS: OsStackMonitoring=true, OsUseGetServiceId=true, OsUseParameterAccess=true, OsScalabilityClass=SC1, OsStatus=EXTENDED
      OsHooks: OsErrorHook=false, OsPostTaskHook=false, OsPreTaskHook=false, OsProtectionHook=false, OsShutdownHook=false, OsStartupHook=true
      OsHookStack: OsHookStackSize=512
    4 x OsTask, all with OsTaskActivation=1, OsTaskStackSize=592:
      main_task: OsTaskPriority=5, OsTaskSchedule=FULL, OsTaskResourceRef=INTERNAL_RES
        OsTaskAutostart: OsTaskAppModeRef=AppMode1
      hpri_task: OsTaskPriority=10, OsTaskSchedule=NON
      mpri_task: OsTaskPriority=8, OsTaskSchedule=FULL, OsTaskResourceRef=INTERNAL_RES
      lpri_task: OsTaskPriority=6, OsTaskSchedule=NON
    psw2_int (OsIsr): OsIsrInterruptNumber=36, OsIsrInterruptPriority=6, OsIsrStackSize=592, OsIsrCategory=CATEGORY_2, OsIsrInterruptSource=ENABLE
    psw1_int (OsIsr): OsIsrInterruptNumber=35, OsIsrInterruptPriority=3, OsIsrStackSize=592, OsIsrCategory=CATEGORY_2, OsIsrInterruptSource=ENABLE
    INTERNAL_RES (OsResource): OsResourceProperty=INTERNAL
