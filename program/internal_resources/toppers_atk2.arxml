AUTOSAR XML (schema 4-0-3)
# Copyright (C) 2011-2013 by Center for Embedded Computing Systems
# Graduate School of Information Science, Nagoya Univ., JAPAN
# Copyright (C) 2011-2013 by FUJISOFT INCORPORATED, JAPAN
# Copyright (C) 2011-2013 by FUJITSU VLSI LIMITED, JAPAN
# Copyright (C) 2011-2013 by NEC Communication Systems, Ltd., JAPAN
# Copyright (C) 2011-2013 by Panasonic Advanced Technology Development Co., Ltd., JAPAN
# Copyright (C) 2011-2013 by Renesas Electronics Corporation, JAPAN
# Copyright (C) 2011-2013 by Sunny Giken Inc., JAPAN
# Copyright (C) 2011-2013 by TOSHIBA CORPORATION, JAPAN
# Copyright (C) 2011-2013 by Witz Corporation, JAPAN
package /Ecuc
  module config Os: ecuc-def-edition=4.0.3, implementation-config-variant=VARIANT-PRE-COMPILE
    OsInclude: OsIncludeFileName=toppers_atk2.h
    AppMode1 (OsAppMode)
    OsOS: OsScalabilityClass=SC1, OsStackMonitoring=true, OsStatus=EXTENDED, OsUseGetServiceId=true, OsUseParameterAccess=true
      OsHooks: OsErrorHook=false, OsPostTaskHook=false, OsPreTaskHook=false, OsProtectionHook=false, OsShutdownHook=false, OsStartupHook=true
      OsHookStack: OsHookStackSize=0x200
    4 x OsTask, all with OsTaskActivation=1U, OsTaskStackSize=0x250:
      main_task: OsTaskPriority=5, OsTaskSchedule=FULL, OsTaskResourceRef=INTERNAL_RES
        OsTaskAutostart: OsTaskAppModeRef=AppMode1
      hpri_task: OsTaskPriority=10, OsTaskSchedule=NON
      mpri_task: OsTaskPriority=8, OsTaskSchedule=FULL, OsTaskResourceRef=INTERNAL_RES
      lpri_task: OsTaskPriority=6, OsTaskSchedule=NON
    psw2_int (OsIsr): OsIsrCategory=CATEGORY_2, OsIsrInterruptNumber=36, OsIsrInterruptPriority=6, OsIsrStackSize=0x250
    psw1_int (OsIsr): OsIsrCategory=CATEGORY_2, OsIsrInterruptNumber=35, OsIsrInterruptPriority=3, OsIsrStackSize=0x250
    INTERNAL_RES (OsResource): OsResourceProperty=INTERNAL
