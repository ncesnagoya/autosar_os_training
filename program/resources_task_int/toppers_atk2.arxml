AUTOSAR XML (schema 4-0-3)
package /Ecuc
  module config Os: ecuc-def-edition=4.2.0, implementation-config-variant=VARIANT-PRE-COMPILE
    OsInclude: OsIncludeFileName=toppers_atk2.h
    AppMode1 (OsAppMode)
    OsOS: OsStackMonitoring=true, OsUseGetServiceId=true, OsUseParameterAccess=true, OsScalabilityClass=SC1, OsStatus=EXTENDED
      OsHooks: OsErrorHook=false, OsPostTaskHook=false, OsPreTaskHook=false, OsProtectionHook=false, OsShutdownHook=false, OsStartupHook=true
      OsHookStack: OsHookStackSize=512
    main_task (OsTask): OsTaskActivation=1, OsTaskPriority=5, OsTaskStackSize=592, OsTaskSchedule=FULL, OsTaskResourceRef=RES_INT_PSW2
      OsTaskAutostart: OsTaskAppModeRef=AppMode1
    hpri_task (OsTask): OsTaskActivation=1, OsTaskPriority=10, OsTaskStackSize=592, OsTaskSchedule=NON, OsTaskResourceRef=RES_TASK
    psw2_int (OsIsr):
      OsIsrInterruptNumber = 36
      OsIsrInterruptPriority = 6
      OsIsrStackSize = 592
      OsIsrCategory = CATEGORY_2
      OsIsrInterruptSource = ENABLE
      OsIsrResourceRef = RES_INT_PSW2
    psw1_int (OsIsr):
      OsIsrInterruptNumber = 35
      OsIsrInterruptPriority = 3
      OsIsrStackSize = 592
      OsIsrCategory = CATEGORY_2
      OsIsrInterruptSource = ENABLE
      OsIsrResourceRef = RES_INT_PSW1
    3 x OsResource, all with OsResourceProperty=STANDARD:
      RES_TASK
      RES_INT_PSW1
      RES_INT_PSW2
