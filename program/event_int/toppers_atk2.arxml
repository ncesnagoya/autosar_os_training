AUTOSAR XML (schema 4-0-3)
package /Ecuc
  module config Os: ecuc-def-edition=4.2.0, implementation-config-variant=VARIANT-PRE-COMPILE
    OsInclude: OsIncludeFileName=toppers_atk2.h
    AppMode1 (OsAppMode)
    OsOS: OsStackMonitoring=true, OsUseGetServiceId=true, OsUseParameterAccess=true, OsScalabilityClass=SC1, OsStatus=EXTENDED
      OsHooks: OsErrorHook=false, OsPostTaskHook=false, OsPreTaskHook=false, OsProtectionHook=false, OsShutdownHook=false, OsStartupHook=true
      OsHookStack: OsHookStackSize=512
    main_task (OsTask): OsTaskActivation=1, OsTaskPriority=5, OsTaskStackSize=592, OsTaskSchedule=NON, OsTaskEventRef=EVENT_PSW1, OsTaskEventRef=EVENT_PSW2
      OsTaskAutostart: OsTaskAppModeRef=AppMode1
    EVENT_PSW1 (OsEvent)
    EVENT_PSW2 (OsEvent)
    psw2_int (OsIsr): OsIsrInterruptNumber=36, OsIsrInterruptPriority=5, OsIsrCategory=CATEGORY_2, OsIsrInterruptSource=ENABLE
    psw1_int (OsIsr): OsIsrInterruptNumber=35, OsIsrInterruptPriority=3, OsIsrStackSize=592, OsIsrCategory=CATEGORY_2, OsIsrInterruptSource=ENABLE
