AUTOSAR XML (schema 4-0-3)
# Copyright (C) 2011-2013 by Center for Embedded Computing Systems
# Graduate School of Information Science, Nagoya Univ., JAPAN
# Copyright (C) 2011-2013 by FUJISOFT INCORPORATED, JAPAN
# Copyright (C) 2011-2013 by FUJITSU VLSI LIMITED, JAPAN
# Copyright (C) 2011-2013 by NEC Communication Systems, Ltd., JAPAN
# Copyright (C) 2011-2013 by Panasonic Advanced Technology Development Co., Ltd., JAPAN
# Copyright (C) 2011-2013 by Renesas Electronics Corporation, JAPAN
# Copyright (C) 2011-2013 by Sunny Giken Inc., JAPAN
# Copyright (C) 2011-2013 by TOSHIBA CORPORATION, JAPAN
# Copyright (C) 2011-2013 by Witz Corporation, JAPAN
package /Ecuc
  module config Os: ecuc-def-edition=4.0.3, implementation-config-variant=VARIANT-PRE-COMPILE
    OsInclude: OsIncludeFileName=toppers_atk2.h
    AppMode1 (OsAppMode)
    OsOS: OsScalabilityClass=SC1, OsStackMonitoring=true, OsStatus=EXTENDED, OsUseGetServiceId=true, OsUseParameterAccess=true
      OsHooks: OsErrorHook=false, OsPostTaskHook=false, OsPreTaskHook=false, OsProtectionHook=false, OsShutdownHook=false, OsStartupHook=true
      OsHookStack: OsHookStackSize=0x200
    main_task (OsTask): OsTaskActivation=1U, OsTaskPriority=5, OsTaskSchedule=NON, OsTaskStackSize=0x250, OsTaskEventRef=EVENT_PSW1, OsTaskEventRef=EVENT_PSW2
      OsTaskAutostart: OsTaskAppModeRef=AppMode1
    EVENT_PSW1 (OsEvent)
    EVENT_PSW2 (OsEvent)
    psw2_int (OsIsr): OsIsrCategory=CATEGORY_2, OsIsrInterruptNumber=36, OsIsrInterruptPriority=5
    psw1_int (OsIsr): OsIsrCategory=CATEGORY_2, OsIsrInterruptNumber=35, OsIsrInterruptPriority=3, OsIsrStackSize=0x250
