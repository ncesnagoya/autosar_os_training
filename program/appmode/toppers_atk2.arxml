AUTOSAR XML (schema 4-0-3)
package /Ecuc
  module config Os: ecuc-def-edition=4.2.0, implementation-config-variant=VARIANT-PRE-COMPILE
    OsInclude: OsIncludeFileName=toppers_atk2.h
    3 x OsAppMode:
      AppMode{1..3}
    OsOS: OsStackMonitoring=true, OsUseGetServiceId=true, OsUseParameterAccess=true, OsScalabilityClass=SC1, OsStatus=EXTENDED
      OsHooks: OsErrorHook=false, OsPostTaskHook=false, OsPreTaskHook=false, OsProtectionHook=false, OsShutdownHook=false, OsStartupHook=true
      OsHookStack: OsHookStackSize=512
    task1 (OsTask): OsTaskActivation=1, OsTaskPriority=10, OsTaskStackSize=592, OsTaskSchedule=FULL, OsTaskEventRef=EVENT_WUP
      OsTaskAutostart: OsTaskAppModeRef=AppMode1, OsTaskAppModeRef=AppMode3
    task2 (OsTask): OsTaskActivation=1, OsTaskPriority=10, OsTaskStackSize=592, OsTaskSchedule=FULL, OsTaskEventRef=EVENT_WUP
      OsTaskAutostart: OsTaskAppModeRef=AppMode2, OsTaskAppModeRef=AppMode3
    EVENT_WUP (OsEvent)
    alarm_event1 (OsAlarm): OsAlarmCounterRef=MAIN_HW_COUNTER
      OsAlarmAction
        OsAlarmSetEvent: OsAlarmSetEventTaskRef=task1, OsAlarmSetEventRef=EVENT_WUP
      OsAlarmAutostart:
        OsAlarmAlarmTime = TICK_FOR_10MS*100
        OsAlarmCycleTime = TICK_FOR_10MS*100
        OsAlarmAutostartType = ABSOLUTE
        OsAlarmAppModeRef = AppMode{1..3}
    alarm_event2 (OsAlarm): OsAlarmCounterRef=MAIN_HW_COUNTER
      OsAlarmAction
        OsAlarmSetEvent: OsAlarmSetEventTaskRef=task2, OsAlarmSetEventRef=EVENT_WUP
      OsAlarmAutostart:
        OsAlarmAlarmTime = TICK_FOR_10MS*100
        OsAlarmCycleTime = TICK_FOR_10MS*100
        OsAlarmAutostartType = ABSOLUTE
        OsAlarmAppModeRef = AppMode{1..3}
