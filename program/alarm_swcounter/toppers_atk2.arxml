AUTOSAR XML (schema 4-0-3)
package /Ecuc
  module config Os: ecuc-def-edition=4.2.0, implementation-config-variant=VARIANT-PRE-COMPILE
    OsInclude: OsIncludeFileName=toppers_atk2.h
    AppMode1 (OsAppMode)
    OsOS: OsStackMonitoring=true, OsUseGetServiceId=true, OsUseParameterAccess=true, OsScalabilityClass=SC1, OsStatus=EXTENDED
      OsHooks: OsErrorHook=false, OsPostTaskHook=false, OsPreTaskHook=false, OsProtectionHook=false, OsShutdownHook=false, OsStartupHook=true
      OsHookStack: OsHookStackSize=512
    3 x OsTask, all with OsTaskActivation=1, OsTaskStackSize=592, OsTaskSchedule=FULL:
      main_task: OsTaskPriority=5
        OsTaskAutostart: OsTaskAppModeRef=AppMode1
      hpri_task: OsTaskPriority=10
      event_task: OsTaskPriority=10, OsTaskEventRef=EVENT_WUP
        OsTaskAutostart: OsTaskAppModeRef=AppMode1
    EVENT_WUP (OsEvent)
    3 x OsAlarm, all with OsAlarmCounterRef=SW_Cnt:
      alarm_act_task
        OsAlarmAction
          OsAlarmActivateTask: OsAlarmActivateTaskRef=hpri_task
      alarm_event
        OsAlarmAction
          OsAlarmSetEvent: OsAlarmSetEventTaskRef=event_task, OsAlarmSetEventRef=EVENT_WUP
      alarm_callback
        OsAlarmAction
          OsAlarmCallback: OsAlarmCallbackName=func_alarm_callback
    SW_Cnt (OsCounter): OsCounterMaxAllowedValue=99, OsCounterMinCycle=1, OsCounterTicksPerBase=1, OsCounterType=SOFTWARE, OsCounterIsrRef=psw1_int
    psw1_int (OsIsr): OsIsrInterruptNumber=35, OsIsrInterruptPriority=3, OsIsrStackSize=592, OsIsrCategory=CATEGORY_2, OsIsrInterruptSource=ENABLE
