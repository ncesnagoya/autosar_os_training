AUTOSAR XML (schema 4-0-3)
# Copyright (C) 2011-2013 by Center for Embedded Computing Systems
# Graduate School of Information Science, Nagoya Univ., JAPAN
# Copyright (C) 2011-2013 by FUJISOFT INCORPORATED, JAPAN
# Copyright (C) 2011-2013 by FUJITSU VLSI LIMITED, JAPAN
# Copyright (C) 2011-2013 by NEC Communication Systems, Ltd., JAPAN
# Copyright (C) 2011-2013 by Panasonic Advanced Technology Development Co., Ltd., JAPAN
# Copyright (C) 2011-2013 by Renesas Electronics Corporation, JAPAN
# Copyright (C) 2011-2013 by Sunny Giken Inc., JAPAN
# Copyright (C) 2011-2013 by TOSHIBA CORPORATION, JAPAN
# Copyright (C) 2011-2013 by Witz Corporation, JAPAN
package /Ecuc
  module config Os: ecuc-def-edition=4.0.3, implementation-config-variant=VARIANT-PRE-COMPILE
    OsInclude: OsIncludeFileName=toppers_atk2.h
    AppMode1 (OsAppMode)
    OsOS: OsScalabilityClass=SC1, OsStackMonitoring=true, OsStatus=EXTENDED, OsUseGetServiceId=true, OsUseParameterAccess=true
      OsHooks: OsErrorHook=false, OsPostTaskHook=false, OsPreTaskHook=false, OsProtectionHook=false, OsShutdownHook=false, OsStartupHook=true
      OsHookStack: OsHookStackSize=0x200
    3 x OsTask, all with OsTaskActivation=1U, OsTaskSchedule=FULL, OsTaskStackSize=0x250:
      main_task: OsTaskPriority=5
        OsTaskAutostart: OsTaskAppModeRef=AppMode1
      hpri_task: OsTaskPriority=10
      event_task: OsTaskPriority=10, OsTaskEventRef=EVENT_WUP
        OsTaskAutostart: OsTaskAppModeRef=AppMode1
    EVENT_WUP (OsEvent)
    3 x OsAlarm, all with OsAlarmCounterRef=MAIN_HW_COUNTER:
      alarm_act_task
        OsAlarmAction
          OsAlarmActivateTask: OsAlarmActivateTaskRef=hpri_task
      alarm_event
        OsAlarmAction
          OsAlarmSetEvent: OsAlarmSetEventTaskRef=event_task, OsAlarmSetEventRef=EVENT_WUP
      alarm_callback
        OsAlarmAction
          OsAlarmCallback: OsAlarmCallbackName=func_alarm_callback
