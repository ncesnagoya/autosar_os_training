AUTOSAR XML (schema 4-0-3)
package /Ecuc
  module config Os: ecuc-def-edition=4.2.0, implementation-config-variant=VARIANT-PRE-COMPILE
    OsInclude: OsIncludeFileName=sample1.h
    3 x OsAppMode:
      AppMode{1..3}
    OsOS: OsStackMonitoring=true, OsUseGetServiceId=true, OsUseParameterAccess=true, OsScalabilityClass=SC1, OsStatus=EXTENDED
      OsHooks: OsErrorHook=true, OsPostTaskHook=true, OsPreTaskHook=true, OsProtectionHook=true, OsShutdownHook=true, OsStartupHook=true
      OsHookStack: OsHookStackSize=512
    3 x OsEvent:
      MainEvt
      T2Evt
      T3Evt: OsEventMask=65536
    SampleCnt (OsCounter): OsCounterMaxAllowedValue=99U, OsCounterMinCycle=10, OsCounterTicksPerBase=10U, OsCounterType=SOFTWARE
    4 x OsTask, all with OsTaskStackSize=592:
      MainTask: OsTaskActivation=1U, OsTaskPriority=14, OsTaskSchedule=NON, OsTaskEventRef=MainEvt
        OsTaskAutostart: OsTaskAppModeRef=AppMode1, OsTaskAppModeRef=AppMode2, OsTaskAppModeRef=AppMode3
      HighPriorityTask: OsTaskActivation=1U, OsTaskPriority=15, OsTaskSchedule=FULL
      NonPriTask: OsTaskActivation=8U, OsTaskPriority=1, OsTaskSchedule=NON
      Task1: OsTaskActivation=8U, OsTaskPriority=4, OsTaskSchedule=FULL, OsTaskResourceRef=CntRes, OsTaskResourceRef=TskLevelRes
        OsTaskAutostart: OsTaskAppModeRef=AppMode2
    T6Evt (OsEvent)
    Task2 (OsTask):
      OsTaskActivation = 1U
      OsTaskPriority = 7
      OsTaskStackSize = 592
      OsTaskSchedule = FULL
      OsTaskResourceRef = CntRes
      OsTaskResourceRef = TskLevelRes
      OsTaskEventRef = T2Evt
    4 x OsAlarm, all with OsAlarmCounterRef=MAIN_HW_COUNTER:
      MainCycArm
        OsAlarmAction
          OsAlarmSetEvent: OsAlarmSetEventTaskRef=MainTask, OsAlarmSetEventRef=MainEvt
      ActTskArm
        OsAlarmAction
          OsAlarmActivateTask: OsAlarmActivateTaskRef=Task1
      SetEvtArm
        OsAlarmAction
          OsAlarmSetEvent: OsAlarmSetEventTaskRef=Task3, OsAlarmSetEventRef=T3Evt
      CallBackArm
        OsAlarmAction
          OsAlarmCallback: OsAlarmCallbackName=SysTimerAlmCb
    T7Evt (OsEvent)
    T8Evt (OsEvent)
    Task3 (OsTask): OsTaskActivation=1U, OsTaskPriority=12, OsTaskStackSize=592, OsTaskSchedule=FULL, OsTaskResourceRef=CntRes, OsTaskEventRef=T3Evt
      OsTaskAutostart: OsTaskAppModeRef=AppMode3
    Task4 (OsTask):
      OsTaskActivation = 5U
      OsTaskPriority = 6
      OsTaskStackSize = 592
      OsTaskSchedule = FULL
      OsTaskResourceRef = GroupRes
      OsTaskResourceRef = CntRes
      OsTaskResourceRef = TskLevelRes
    TskLevelRes (OsResource): OsResourceProperty=STANDARD
    CntRes (OsResource): OsResourceProperty=STANDARD
    SampleAlm (OsAlarm): OsAlarmCounterRef=SampleCnt
      OsAlarmAction
        OsAlarmCallback: OsAlarmCallbackName=SampleAlmCb
      OsAlarmAutostart:
        OsAlarmAlarmTime = 10U
        OsAlarmCycleTime = 10U
        OsAlarmAutostartType = ABSOLUTE
        OsAlarmAppModeRef = AppMode{1..3}
    scheduletable1 (OsScheduleTable): OsScheduleTableDuration=60U, OsScheduleTableRepeating=true, OsScheduleTableCounterRef=SchtblSampleCnt
      OsScheduleTableExpiryPoint_0 (OsScheduleTableExpiryPoint): OsScheduleTblExpPointOffset=10
        3 x OsScheduleTableTaskActivation:
          OsScheduleTableTaskActivation_0: OsScheduleTableActivateTaskRef=Task6
          OsScheduleTableTaskActivation_1: OsScheduleTableActivateTaskRef=Task7
          OsScheduleTableTaskActivation_2: OsScheduleTableActivateTaskRef=Task8
      OsScheduleTableExpiryPoint_1 (OsScheduleTableExpiryPoint): OsScheduleTblExpPointOffset=20
        3 x OsScheduleTableEventSetting:
          OsScheduleTableEventSetting_0: OsScheduleTableSetEventRef=T6Evt, OsScheduleTableSetEventTaskRef=Task6
          OsScheduleTableEventSetting_1: OsScheduleTableSetEventRef=T7Evt, OsScheduleTableSetEventTaskRef=Task7
          OsScheduleTableEventSetting_2: OsScheduleTableSetEventRef=T8Evt, OsScheduleTableSetEventTaskRef=Task8
      OsScheduleTableSync: OsScheduleTblSyncStrategy=NONE
    Task5 (OsTask):
      OsTaskActivation = 5U
      OsTaskPriority = 9
      OsTaskStackSize = 592
      OsTaskSchedule = FULL
      OsTaskResourceRef = GroupRes
      OsTaskResourceRef = CntRes
      OsTaskResourceRef = TskLevelRes
    GroupRes (OsResource): OsResourceProperty=INTERNAL
    scheduletable2 (OsScheduleTable): OsScheduleTableDuration=50U, OsScheduleTableRepeating=true, OsScheduleTableCounterRef=SchtblSampleCnt
      3 x OsScheduleTableExpiryPoint:
        OsScheduleTableExpiryPoint_0: OsScheduleTblExpPointOffset=20
          OsScheduleTableTaskActivation_0 (OsScheduleTableTaskActivation): OsScheduleTableActivateTaskRef=Task8
          OsScheduleTableTaskActivation_1 (OsScheduleTableTaskActivation): OsScheduleTableActivateTaskRef=Task7
        OsScheduleTableExpiryPoint_1: OsScheduleTblExpPointOffset=30
          OsScheduleTableEventSetting_0 (OsScheduleTableEventSetting): OsScheduleTableSetEventRef=T8Evt, OsScheduleTableSetEventTaskRef=Task8
        OsScheduleTableExpiryPoint_2: OsScheduleTblExpPointOffset=40
          OsScheduleTableEventSetting_0 (OsScheduleTableEventSetting): OsScheduleTableSetEventRef=T7Evt, OsScheduleTableSetEventTaskRef=Task7
      OsScheduleTableSync: OsScheduleTblSyncStrategy=NONE
    Task6 (OsTask): OsTaskActivation=1U, OsTaskPriority=13, OsTaskStackSize=592, OsTaskSchedule=NON, OsTaskEventRef=T6Evt
    SampleAlm1 (OsAlarm): OsAlarmCounterRef=SampleCnt2
      OsAlarmAction
        OsAlarmIncrementCounter: OsAlarmIncrementCounterRef=SampleCnt3
      OsAlarmAutostart:
        OsAlarmAlarmTime = 10U
        OsAlarmCycleTime = 10U
        OsAlarmAutostartType = ABSOLUTE
        OsAlarmAppModeRef = AppMode{1..3}
    Task7 (OsTask): OsTaskActivation=1U, OsTaskPriority=13, OsTaskStackSize=592, OsTaskSchedule=NON, OsTaskEventRef=T7Evt
    SampleCnt2 (OsCounter): OsCounterMaxAllowedValue=99U, OsCounterMinCycle=10, OsCounterTicksPerBase=10U, OsCounterType=SOFTWARE
    SampleAlm2 (OsAlarm): OsAlarmCounterRef=SampleCnt3
      OsAlarmAction
        OsAlarmCallback: OsAlarmCallbackName=SampleAlmCb2
      OsAlarmAutostart:
        OsAlarmAlarmTime = 10U
        OsAlarmCycleTime = 10U
        OsAlarmAutostartType = ABSOLUTE
        OsAlarmAppModeRef = AppMode{1..3}
    Task8 (OsTask): OsTaskActivation=1U, OsTaskPriority=13, OsTaskStackSize=592, OsTaskSchedule=NON, OsTaskEventRef=T8Evt
    SampleCnt3 (OsCounter): OsCounterMaxAllowedValue=99U, OsCounterMinCycle=10, OsCounterTicksPerBase=10U, OsCounterType=SOFTWARE
    SchtblSampleCnt (OsCounter): OsCounterMaxAllowedValue=99U, OsCounterMinCycle=10, OsCounterTicksPerBase=10U, OsCounterType=SOFTWARE
