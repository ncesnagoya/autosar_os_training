AUTOSAR XML (schema 4-0-3)
package /Ecuc
  module config Os: ecuc-def-edition=4.2.0, implementation-config-variant=VARIANT-PRE-COMPILE
    OsInclude: OsIncludeFileName=toppers_atk2.h
    AppMode1 (OsAppMode)
    OsOS: OsStackMonitoring=true, OsUseGetServiceId=true, OsUseParameterAccess=true, OsScalabilityClass=SC1, OsStatus=EXTENDED
      OsHooks: OsErrorHook=false, OsPostTaskHook=false, OsPreTaskHook=false, OsProtectionHook=false, OsShutdownHook=false, OsStartupHook=true
      OsHookStack: OsHookStackSize=512
    dip_task (OsTask): OsTaskActivation=1, OsTaskPriority=5, OsTaskStackSize=592, OsTaskSchedule=NON
      OsTaskAutostart: OsTaskAppModeRef=AppMode1
    led_task (OsTask):
      OsTaskActivation = 1
      OsTaskPriority = 6
      OsTaskStackSize = 592
      OsTaskSchedule = NON
      OsTaskEventRef = DSW1_ON
      OsTaskEventRef = DSW1_OFF
      OsTaskEventRef = DSW2_ON
      OsTaskEventRef = DSW2_OFF
      OsTaskEventRef = DSW3_ON
      OsTaskEventRef = DSW3_OFF
      OsTaskEventRef = DSW4_ON
      OsTaskEventRef = DSW4_OFF
      OsTaskAutostart: OsTaskAppModeRef=AppMode1
    8 x OsEvent:
      DSW1_ON
      DSW1_OFF
      DSW2_ON
      DSW2_OFF
      DSW3_ON
      DSW3_OFF
      DSW4_ON
      DSW4_OFF
