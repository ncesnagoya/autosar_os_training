AUTOSAR XML (schema 4-0-3)
# Copyright (C) 2011-2013 by Center for Embedded Computing Systems
# Graduate School of Information Science, Nagoya Univ., JAPAN
# Copyright (C) 2011-2013 by FUJISOFT INCORPORATED, JAPAN
# Copyright (C) 2011-2013 by FUJITSU VLSI LIMITED, JAPAN
# Copyright (C) 2011-2013 by NEC Communication Systems, Ltd., JAPAN
# Copyright (C) 2011-2013 by Panasonic Advanced Technology Development Co., Ltd., JAPAN
# Copyright (C) 2011-2013 by Renesas Electronics Corporation, JAPAN
# Copyright (C) 2011-2013 by Sunny Giken Inc., JAPAN
# Copyright (C) 2011-2013 by TOSHIBA CORPORATION, JAPAN
# Copyright (C) 2011-2013 by Witz Corporation, JAPAN
package /Ecuc
  module config Os: ecuc-def-edition=4.0.3, implementation-config-variant=VARIANT-PRE-COMPILE
    OsInclude: OsIncludeFileName=toppers_atk2.h
    AppMode1 (OsAppMode)
    OsOS: OsScalabilityClass=SC1, OsStackMonitoring=true, OsStatus=EXTENDED, OsUseGetServiceId=true, OsUseParameterAccess=true
      OsHooks: OsErrorHook=false, OsPostTaskHook=false, OsPreTaskHook=false, OsProtectionHook=false, OsShutdownHook=false, OsStartupHook=true
      OsHookStack: OsHookStackSize=0x200
    dip_task (OsTask): OsTaskActivation=1U, OsTaskPriority=5, OsTaskSchedule=NON, OsTaskStackSize=0x250
      OsTaskAutostart: OsTaskAppModeRef=AppMode1
    led_task (OsTask):
      OsTaskActivation = 1U
      OsTaskPriority = 6
      OsTaskSchedule = NON
      OsTaskStackSize = 0x250
      OsTaskEventRef = DSW1_ON
      OsTaskEventRef = DSW1_OFF
      OsTaskEventRef = DSW2_ON
      OsTaskEventRef = DSW2_OFF
      OsTaskEventRef = DSW3_ON
      OsTaskEventRef = DSW3_OFF
      OsTaskEventRef = DSW4_ON
      OsTaskEventRef = DSW4_OFF
      OsTaskAutostart: OsTaskAppModeRef=AppMode1
    8 x OsEvent:
      DSW1_ON
      DSW1_OFF
      DSW2_ON
      DSW2_OFF
      DSW3_ON
      DSW3_OFF
      DSW4_ON
      DSW4_OFF
